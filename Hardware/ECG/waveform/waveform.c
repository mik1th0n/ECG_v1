/*
*********************************************************************************************************
*
*	模块名称 : uCOS-III
*	文件名称 : waveform.c
*	版    本 : V1.0
*	说    明 : 波形显示界面
*
*
*	修改记录 :
*		版本号  日期        作者     说明
*		V1.0    2017-03-25    CML       ECG程序代码
*
*	Copyright (C), 2015-2016, CML
*
*********************************************************************************************************
*/

/*
*********************************************************************************************************
*                                       包含头文件
*********************************************************************************************************
*/                                                          
#include "sys.h"
#include "delay.h"
#include "ILI93xx.h"
#include "waveform.h"
#include "adc.h"
#include "bsp_usart1.h"

/*
*********************************************************************************************************
*                                       私有变量定义
*********************************************************************************************************
*/
u16   buf[350];
u16   table[11]  ={0,25,50,75,100,125,150,175,200,225,250};
u16		table1[41] ={0,5,10,15,20,30,35,40,45,55,60,65,70,80,85,
										90,95,105,110,115,120,130,135,140,145,155,
										160,165,170,180,185,190,195,205,210,215,220,
										230,235,240,245};
u16 Ypos1=100,Ypos2=100,Xpos1,Xpos2;
u16 adcx,dsl;
u16  t=0;
u16  h=0;
u16 d=0;
u32 tim=500;		/* 根据频率修改采样间隔 */
u32 bei=1;
u16 Yinit=12; //75
u8 a;
u8 len;										

/*
*********************************************************************************************************
*	函 数 名: Draw_Coordinate
*	功能说明: 画网格函数
*	输入参数: 无
*	返 回 值: 无
* 其    它：
* 日    期：2017.4.2  11:12
*********************************************************************************************************
*/
void Draw_Coordinate(void)
{
	int x = 0;
	int y = 0;
	u32 num = 0;
	
	/* 纵坐标数值显示 */
	for(y=6,num=0;y<200;y+=10,num+=100)
	{
		LCD_ShowxNum(255,(u8)y,num,4,12,1);
	}
	/* 纵坐标单位显示 */
	for(y=6;y<200;y+=10)
	{
		LCD_ShowString(287,y,20,24,12,"mv");
	}
	
	/* 横坐标数值显示 */
	for (x=0,num=100;x<251;x+=23,num-=10)
	{
		LCD_ShowxNum(x,0,num,3,12,1);
	}
	/* 纵坐标单位显示 */
	for(x=18;y<251;y+=23)
	{
		LCD_ShowString(x,0,20,24,12,"s");
	}

}

/*
*********************************************************************************************************
*	函 数 名: Draw_Gaid
*	功能说明: 画网格函数
*	输入参数: 无
*	返 回 值: 无
* 其    它：
* 日    期：2017.4.2  11:12
*********************************************************************************************************
*/
/*
void Draw_Gaid(void) 
{
	u16 x,y;
	for(x=45;x<246;x=x+25)//25
		for(y=6;y<197;y=y+2)//5
		{
			LCD_Fast_DrawPoint(x,y,YELLOW);
		}
	for(y=6;y<197;y=y+10)
		for(x=45;x<246;x=x+2)//5
		{
			LCD_Fast_DrawPoint(x,y,YELLOW);
		}
}
*/
void Draw_Gaid(void) 
{
	u16 x,y;
	for(x=0;x<251;x=x+25)
		for(y=12;y<203;y=y+5)
		{
			LCD_Fast_DrawPoint(x,y,YELLOW );
		}
	for(y=12;y<203;y=y+10)
		for(x=0;x<251;x=x+2)
		{
			LCD_Fast_DrawPoint(x,y,YELLOW );
		}
}

/*
*********************************************************************************************************
*	函 数 名: Clear_Point
*	功能说明: 更新显示屏当前列
*	输入参数: 无
*	返 回 值: 无
* 其    它：
* 日    期：2017.4.2  11:12
*********************************************************************************************************
*/
void Clear_Point(u16 hang)
{
	u8 index_clear_lie = 0; 
	POINT_COLOR = BLACK ;
	for(index_clear_lie = 12;index_clear_lie <203;index_clear_lie++)
	{		
		LCD_DrawPoint(hang,index_clear_lie );
	}
	if(hang==table[h])//判断hang是否为25的倍数
	{
			for(index_clear_lie = 12;index_clear_lie <203;index_clear_lie=index_clear_lie+5)
			{		
				LCD_Fast_DrawPoint(hang ,index_clear_lie,YELLOW );
			}
			h++;
			if(h>10) h=0;
	}
	if(hang ==table1[d])//判断hang是否为5的倍数
	{
			for(index_clear_lie = 12;index_clear_lie <203;index_clear_lie=index_clear_lie+10)//25
			{		
				LCD_Fast_DrawPoint(hang ,index_clear_lie,YELLOW );
			}
			d++;
			if(d>40) d=0;
	}
	
	POINT_COLOR=RED;	
}

/*
*********************************************************************************************************
*	函 数 名: Draw_Oscillogram
*	功能说明: 画波形图
*	输入参数: 无
*	返 回 值: 无
* 其    它：
* 日    期：2017.4.2  11:12
*********************************************************************************************************
*/
void Draw_Oscillogram(void)
{
		for(t=0;t<300;t++)//存储AD数值
		{
			buf[t] = Get_Adc(ADC_Channel_1);
			if(tim>1)
				Delay_NOP_us(tim);//改变AD取样间隔
		}
		
		for(t=0;t<251;t++)
		{
			Clear_Point(t);	
			Ypos2=Yinit+buf[t]*100/4096; /* 转换坐标 */
			Ypos2=Ypos2*bei;
			if(Ypos2 >200) Ypos2 =200; /* 超出范围不显示 */
			LCD_DrawLine (t ,Ypos1 , t+1 ,Ypos2  );/* 起点坐标：x，y,终点坐标x,y */
			Ypos1 =Ypos2 ;
		}	
}

/*
*********************************************************************************************************
*	函 数 名: Get_Vpp
*	功能说明: 获取峰峰值
*	输入参数: 无
*	返 回 值: 无
* 其    它：
* 日    期：2017.4.2  11:12
*********************************************************************************************************
*/
float Get_Vpp(void)	   
{
	
	u32 max_data=buf[0];
	u32 min_data=buf[0];
	u32 n=0;
	float Vpp=0;
	for(n = 1;n<201;n++)
	{
		if(buf[n]>max_data)
		{
			max_data = buf[n];
		}
		if(buf[n]<min_data)
		{
			min_data = buf[n];
		}			
	} 	
	Vpp = (float)(max_data-min_data);
	Vpp = Vpp*(3300.0/4095);
	return Vpp;	
}

/*
*********************************************************************************************************
*	函 数 名: Usartkeyscan
*	功能说明: 蓝牙按键扫描
*	输入参数: 无
*	返 回 值: 无
* 其    它：
* 日    期：2017.4.2  11:12
*********************************************************************************************************
*/
/*
void Usart_Keyscan(void)  
{
		if(USART_RX_STA&0x8000)	 
		 {
				 len =USART_RX_STA &0x3fff;
				 for(t=0;t<len;t++)
				 {
					 a=USART_RX_BUF[t];
					 USART1->DR =a;
					 while((USART1->SR&0X40)==0);//等待发送结束
				 }
				 USART_RX_STA=0;
				 if( USART_RX_BUF[0]=='K') Yinit=Yinit -25 ;
				 if( USART_RX_BUF[0]=='O') Yinit =Yinit +25 ;
				 if( USART_RX_BUF[0]=='J') 
				 {
					 tim /=2 ;
					 LCD_ShowxNum(284,220,tim ,3,16,0);
				 }
				 if( USART_RX_BUF[0]=='D') 
				 {
					 tim *=2 ;
					 LCD_ShowxNum(284,220,tim ,3,16,0);
				 }
				 if( USART_RX_BUF[0]=='S') 
				 { 
						bei =bei*2;
					 if(bei>3) bei=1;
				 }
				 
				 if(USART_RX_BUF[0]=='O'&&USART_RX_BUF[1]=='K')
				 {
					 while(USART_RX_STA==0&& d<20)
					 {
							LED0 =!LED0 ;
							d++;
							delay_ms (1000);
					 }
					 d=0;
				 }
			 
		 }
}
*/

/******************************************* (END OF FILE) *********************************************/

